## drivers/misc/Kconfig
```kconfig
#
# Misc strange devices
#

menu "Misc devices"

config IBM_ASM
	tristate "Device driver for IBM RSA service processor"
	depends on X86 && EXPERIMENTAL
	default n
	---help---
	  This option enables device driver support for in-band access to the
	  IBM RSA (Condor) service processor in eServer xSeries systems.
	  The ibmasm device driver allows user space application to access
	  ASM (Advanced Systems Management) functions on the service
	  processor. The driver is meant to be used in conjunction with
	  a user space API.
	  The ibmasm driver also enables the OS to use the UART on the
	  service processor board as a regular serial port. To make use of
	  this feature serial driver support (CONFIG_SERIAL_8250) must be
	  enabled.
	  
	  WARNING: This software may not be supported or function
	  correctly on your IBM server. Please consult the IBM ServerProven
	  website http://www.pc.ibm/ww/eserver/xseries/serverproven for
	  information on the specific driver level and support statement
	  for your IBM server.


	  If unsure, say N.

endmenu

menu "Multimedia Capabilities Port drivers"

config MCP
	tristate

# Interface drivers
config MCP_SA1100
	tristate "Support SA1100 MCP interface"
	depends on ARCH_SA1100
	select MCP

# Chip drivers
config MCP_UCB1200
	tristate "Support for UCB1200 / UCB1300"
	depends on MCP

config MCP_UCB1200_AUDIO
	tristate "Audio / Telephony interface support"
	depends on MCP_UCB1200 && SOUND

config MCP_UCB1200_TS
	tristate "Touchscreen interface support"
	depends on MCP_UCB1200 && INPUT

config UCB1400_TS
	tristate "UCB1400 Touchscreen support"
	depends on (ARCH_PXA && !PXA3xx)
	select SOUND
	select SND
	select SND_PXA2xx_SND

endmenu
```

## drivers/mmc/Kconfig
```kconfig
#
# MMC subsystem configuration
#

menu "MMC/SD Card support"

config MMC
	tristate "MMC support"
	help
	  MMC is the "multi-media card" bus protocol.

	  If you want MMC support, you should say Y here and also
	  to the specific driver for your MMC interface.

config MMC_DEBUG
	bool "MMC debugging"
	depends on MMC != n
	help
	  This is an option for use by developers; most people should
	  say N here.  This enables MMC core and driver debugging.

config MMC_BLOCK
	tristate "MMC block device driver"
	depends on MMC
	default y
	help
	  Say Y here to enable the MMC block device driver support.
	  This provides a block device driver, which you can use to
	  mount the filesystem. Almost everyone wishing MMC support
	  should say Y or M here.

config MMC_BLOCK_BROKEN_RFD
	boolean "Write work-around for incompatible cards"
	depends on MMC_BLOCK
	default n
	help
	  Say y here if your MMC card fails write operations. Some cards
	  lie about being ready to receive data while they actually are not.

config MMC_ARMMMCI
	tristate "ARM AMBA Multimedia Card Interface support"
	depends on ARM_AMBA && MMC
	help
	  This selects the ARM(R) AMBA(R) PrimeCell Multimedia Card
	  Interface (PL180 and PL181) support.  If you have an ARM(R)
	  platform with a Multimedia Card slot, say Y or M here.

	  If unsure, say N.

config MMC_PXA
	tristate "Intel PXA255/PXA3xx Multimedia Card Interface support"
	depends on ARCH_PXA && MMC
	help
	  This selects the Intel(R) PXA(R) Multimedia card Interface.
	  If you have a PXA(R) platform with a Multimedia Card slot,
	  say Y or M here.

	  If unsure, say N.

choice
	prompt "Select slot"

config PXA3xx_MMC1
	bool "Marvell PXA3xx first MMC slot support"
	depends on MMC_PXA && PXA3xx
	default Y
	help
	  This enables the first of two MMC slots on PXA3xx. You need
	  to enable this to activate your second MMC slot.

	  If unsure, say Y.

config PXA3xx_MMC2
	bool "Marvell PXA3xx second MMC slot support"
	depends on MMC_PXA && PXA3xx
	help
	  This enables the second of two MMC slots on PXA3xx. You need
	  to enable this to activate your second MMC slot.

	  If unsure, say N.

endchoice

config PXA310_MMC3
	bool "Marvell PXA310 additional MMC slot support"
	depends on MMC_PXA && PXA310
	help
	  This enables MMC slot on PXA310 daugther card. You need
	  to enable this to activate your PXA310 MMC slot.

	  If unsure, say N.

config MMC_OMAP
	tristate "TI OMAP Multimedia Card Interface support"
	depends on ARCH_OMAP && MMC
	select TPS65010 if MACH_OMAP_H2
	help
	  This selects the TI OMAP Multimedia card Interface.
	  If you have an OMAP board with a Multimedia Card slot,
	  say Y or M here.

	  If unsure, say N.

config MMC_OMAP16XX_BLOCK1
	boolean "First MMC block on OMAP16XX"
	depends on ARCH_OMAP16XX && MMC_OMAP
	default y if MACH_OMAP_H2 || MACH_OMAP_H3
	help
	  This enables the first of two MMC blocks on OMAP1610 multimedia
	  processor. You need to enable the correct block to activate your
	  MMC slot.

config MMC_OMAP16XX_BLOCK2
	boolean "Second MMC block on OMAP16XX"
	depends on ARCH_OMAP16XX && MMC_OMAP
	default n if MACH_OMAP_H2 || MACH_OMAP_H3
	default y
	help
	  This enables the second of two MMC blocks on OMAP1610 multimedia
	  processor. You need to enable the correct block to activate your
	  MMC slot.

config MMC_DAVINCI
	tristate "TI DAVINCI Multimedia Card Interface support"
	depends on MMC
	help
	  This selects the TI DAVINCI Multimedia card Interface.
	  If you have an DAVINCI board with a Multimedia Card slot,
	  say Y or M here.  If unsure, say N.

config MMC_WBSD
	tristate "Winbond W83L51xD SD/MMC Card Interface support"
	depends on MMC
	help
	  This selects the Winbond(R) W83L51xD Secure digital and
          Multimedia card Interface.
	  If you have a machine with a integrated W83L518D or W83L519D
	  SD/MMC card reader, say Y or M here.

	  If unsure, say N.

config MMC_AU1X
	tristate "Alchemy AU1XX0 MMC Card Interface support"
	depends on SOC_AU1X00 && MMC
	help
	  This selects the AMD Alchemy(R) Multimedia card interface.
	  If you have a Alchemy platform with a MMC slot, say Y or M here.

	  If unsure, say N.


endmenu
```

## drivers/scsi/aic94xx/Kconfig
```kconfig
#
# adp94xx 2.5.x kernel configuration file.
#
# $Id: //depot/razor-branch-v12/linux/src/Kconfig#1 $
#
config SCSI_ADP94XX
	tristate "Adaptec AIC94xx SAS/SATA support"
	depends on PCI && SCSI
	help
	This driver supports all of Adaptec's 3Gb/s PCI-X
	based SAS/SATA controllers.
```
