## arch/ppc/platforms/4xx/Kconfig
```kconfig
config 4xx
	bool
	depends on 40x || 44x
	default y

menu "IBM 4xx options"
	depends on 4xx

choice
	prompt "Machine Type"
	depends on 40x
	default WALNUT

config ASH
	bool "Ash"
	help
	  This option enables support for the IBM NP405H evaluation board.

config BUBINGA
	bool "Bubinga"
	help
	  This option enables support for the IBM 405EP evaluation board.

config CPCI405
	bool "CPCI405"
	help
	  This option enables support for the CPCI405 board.

config EP405
	bool "EP405/EP405PC"
	help
	  This option enables support for the EP405/EP405PC boards.

config MEMEC_2VPX
	bool "Memec-2VPx"
	help
	  This option enables support for the Memec-2VP4/2VP7 boards.

config OAK
	bool "Oak"
	help
	  This option enables support for the IBM 403GCX evaluation board.

config REDWOOD_5
	bool "Redwood-5"
	help
	  This option enables support for the IBM STB04 evaluation board.

config REDWOOD_6
	bool "Redwood-6"
	help
	  This option enables support for the IBM STBx25xx evaluation board.

config SYCAMORE
	bool "Sycamore"
	help
	  This option enables support for the IBM PPC405GPr evaluation board.

config WALNUT
	bool "Walnut"
	help
	  This option enables support for the IBM PPC405GP evaluation board.

config XILINX_ML300
	bool "Xilinx-ML300"
	help
	  This option enables support for the Xilinx ML300 evaluation board.

config XILINX_ML40x
	bool "Xilinx-ML40x"
	help
	  This option enables support for the Xilinx ML40x evaluation board.

endchoice

choice
	prompt "Machine Type"
	depends on 44x
	default EBONY

config BAMBOO
	bool "Bamboo"
	help
	  This option enables support for the IBM PPC440EP evaluation board.

config YOSEMITE
	bool "Yosemite"
	help
	  This option enables support for the AMCC PPC440EP evaluation board.

config SEQUOIA
	bool "Sequoia"
	help
	  This option enables support for the AMCC PPC440EPX evaluation board.

config YELLOWSTONE
	bool "Yellowstone"
	help
	  This option enables support for the AMCC PPC440GR evaluation board.

config RAINIER
	bool "Rainier"
	help
	  This option enables support for the AMCC PPC440GRX evaluation board.

config EBONY
	bool "Ebony"
	help
	  This option enables support for the IBM PPC440GP evaluation board.

config LUAN
	bool "Luan"
	help
	  This option enables support for the IBM PPC440SP evaluation board.

config OCOTEA
	bool "Ocotea"
	help
	  This option enables support for the IBM PPC440GX evaluation board.

endchoice

config EP405PC
	bool "EP405PC Support"
	depends on EP405


# It's often necessary to know the specific 4xx processor type.
# Fortunately, it is impled (so far) from the board type, so we
# don't need to ask more redundant questions.
config NP405H
	bool
	depends on ASH
	default y

config 440EP
	bool
	depends on BAMBOO || YOSEMITE
	select PPC_FPU
	default y

config 440EPX
	bool
	depends on SEQUOIA
	select PPC_FPU
	default y

config 440GP
	bool
	depends on EBONY
	default y

config 440GR
	bool
	depends on YELLOWSTONE
	default y

config 440GRX
	bool
	depends on RAINIER
	default y

config 440GX
	bool
	depends on OCOTEA
	default y

config 440SP
	bool
	depends on LUAN
	default y

config 440
	bool
	depends on 440GP || 440SP || 440EP || 440GR
	default y

config 440A
	bool
	depends on 440GX || 440EPX || 440GRX
	default y

config IBM440EP_ERR42
	bool
	depends on 440EP || 440GR
	default y

# All 405-based cores up until the 405GPR and 405EP have this errata.
config IBM405_ERR77
	bool
	depends on 40x && !403GCX && !405GPR
	default y

# All 40x-based cores, up until the 405GPR and 405EP have this errata.
config IBM405_ERR51
	bool
	depends on 40x && !405GPR
	default y

config BOOKE
	bool
	depends on 44x
	default y

config IBM_OCP
	bool
	depends on ASH || BAMBOO || YOSEMITE || YELLOWSTONE || BUBINGA || CPCI405 || EBONY || EP405 || LUAN || OCOTEA || REDWOOD_5 || REDWOOD_6 || SYCAMORE || WALNUT || SEQUOIA || RAINIER
	default y

config XILINX_OCP
	bool
	depends on XILINX_VIRTEX
	default y

config IBM_EMAC4
	bool
	depends on 440GX || 440SP || 440EPX || 440GRX
	default y

config IBM_EMAC4V4
	bool
	depends on 440EPX || 440GRX
 	default y

config BIOS_FIXUP
	bool
	depends on BUBINGA || EP405 || SYCAMORE || WALNUT
	default y

config 403GCX
	bool
	depends OAK
	default y

config 405EP
	bool
	depends on BUBINGA
	default y

config 405GP
	bool
	depends on CPCI405 || EP405 || WALNUT
	default y

config 405GPR
	bool
	depends on SYCAMORE
	default y

config XILINX_VIRTEX_II_PRO
	bool
	depends on XILINX_ML300 || MEMEC_2VPX
	default y

config VIRTEX_II_PRO_TLB_FIX
	bool "Virtex-II Pro TLB bugfix"
	depends on XILINX_VIRTEX_II_PRO
	default n
	help
	  Early versions of the Xilinx Virtex-II Pro have a TLB errata where
	  only even numbered TLB entries work correctly.  Say Y here if
	  PVR == 0x20010820 || 0x20010860, or if your board crashes early
	  after enabling the MMU.

	  See Record #14052, solution #12 in the Xilinx answers database
	  http://www.xilinx.com/xlnx/xil_ans_display.jsp?getPagePath=14052

	  It is safe to say Y here, but there is a performance impact.
	  Say N if unsure.

config XILINX_VIRTEX_4_FX
	bool
	depends on XILINX_ML40x
	default y

config XILINX_VIRTEX
	bool
	depends on XILINX_VIRTEX_II_PRO || XILINX_VIRTEX_4_FX
	default y

config STB03xxx
	bool
	depends on REDWOOD_5 || REDWOOD_6
	default y

config EMBEDDEDBOOT
	bool
	depends on EP405 || XILINX_ML300 || XILINX_ML40x || MEMEC_2VPX
	default y

config IBM_OPENBIOS
	bool
	depends on ASH || BUBINGA || REDWOOD_5 || REDWOOD_6 || SYCAMORE || WALNUT
	default y

config PPC4xx_DMA
	bool "PPC4xx DMA controller support"
	depends on 4xx

config PPC4xx_EDMA
	bool
	depends on !STB03xxx && PPC4xx_DMA
	default y

config PPC_GEN550
	bool
	depends on 4xx
	default y

config PM
	bool "Power Management support (EXPERIMENTAL)"
	depends on 4xx && EXPERIMENTAL

choice
	prompt "TTYS0 device and default console"
	depends on 40x
	default UART0_TTYS0

config UART0_TTYS0
	bool "UART0"

config UART0_TTYS1
	bool "UART1"

endchoice

config SERIAL_SICC
	bool "SICC Serial port support"
	depends on STB03xxx

config UART1_DFLT_CONSOLE
	bool
	depends on SERIAL_SICC && UART0_TTYS1
	default y

config SERIAL_SICC_CONSOLE
	bool
	depends on SERIAL_SICC && UART0_TTYS1
	default y
endmenu
```

## arch/ppc/platforms/83xx/Kconfig
```kconfig
config 834x_USB_SUPPORT
	bool "834x USB Support"
	depends on MPC834x_SYS || MPC834x_ITX
	default y
	---help---
	  Enables support for the USB controllers on the MPC834x chip. The 834x
	  reference board is wired for only one USB port. That port may be
	  used by either the MPH or DR USB controller.
	  Requires USB Host EHCI support.
	  If unsure, say Y.
choice
	prompt "834x USB Controller Selection"
	depends on 834x_USB_SUPPORT
	default 834x_DR_USB_SUPPORT

config 834x_DR_USB_SUPPORT
	bool "DR Controller"
	select USB_EHCI_ROOT_HUB_TT
	---help---
	  Select if using the Dual-Role (DR) USB controller.

config 834x_MPH_USB_SUPPORT
	bool "MPH Controller"
	---help---
	  Select if using the Multi-Port-Host (MPH) USB controller.

endchoice
```

## arch/ppc/platforms/85xx/.svn/text-base/Kconfig.svn-base
```kconfig
config 85xx
	bool
	depends on E500
	default y

config PPC_INDIRECT_PCI_BE
	bool
	depends on 85xx
	default y

menu "Freescale 85xx options"
	depends on E500

choice
	prompt "Machine Type"
	depends on 85xx
	default MPC8540_ADS

config MPC8540_ADS
	bool "Freescale MPC8540 ADS"
	help
	  This option enables support for the MPC 8540 ADS evaluation board.

config MPC8548_CDS
	bool "Freescale MPC8548 CDS"
	help
	  This option enablese support for the MPC8548 CDS evaluation board.

config MPC8555_CDS
	bool "Freescale MPC8555 CDS"
	help
	  This option enablese support for the MPC8555 CDS evaluation board.

config MPC8560_ADS
	bool "Freescale MPC8560 ADS"
	help
	  This option enables support for the MPC 8560 ADS evaluation board.

config SBC8560
	bool "WindRiver PowerQUICC III SBC8560"
	help
	  This option enables support for the WindRiver PowerQUICC III 
	  SBC8560 board.

config STX_GP3
	bool "Silicon Turnkey Express GP3"
	help
	  This option enables support for the Silicon Turnkey Express GP3
	  board.

endchoice

# It's often necessary to know the specific 85xx processor type.
# Fortunately, it is implied (so far) from the board type, so we
# don't need to ask more redundant questions.
config MPC8540
	bool
	depends on MPC8540_ADS
	default y

config MPC8548
	bool
	depends on MPC8548_CDS
	default y

config MPC8555
	bool
	depends on MPC8555_CDS
	default y

config MPC8560
	bool
	depends on SBC8560 || MPC8560_ADS || STX_GP3
	default y

config 85xx_PCI2
	bool "Support for 2nd PCI host controller"
	depends on MPC8555_CDS
	default y

choice
	prompt "Default Arcadia Rev"
	depends on PCI && (MPC8555_CDS || MPC8548_CDS)
	default ARCADIA_X31
	help
	  The interrupt routings differ among the various revisions of the
	  Arcadia. Normally, the proper Arcadia revision can be determined at
	  runtime and this item is not required. However, if the PCI-to-PCI
	  bridge on the Arcadia is disabled, runtime determination of the
	  Arcadia is not possible and this item will be used to set the
	  default Arcadia revision.

config ARCADIA_X2
	bool "Arcadia Rev 2"
	help
	  The Rev 2 Arcadia has 4 64-bit PCI slots with a HIP connector at
	  each slot and a PrPMC connector.

config ARCADIA_X30
	bool "Arcadia Rev 3.0"
	help
	  The Rev 3.0 Arcadia has 4 64-bit PCI slots with HIP connectors at
	  the 2 outermost slots, a PrPMC connector and 2 32-bit PCI slots.

config ARCADIA_X31
	bool "Arcadia Rev 3.1"
	help
	  The Rev 3.1 Arcadia has 4 64-bit PCI slots with HIP connectors at
	  the 2 outermost slots, a PrPMC connector, 2 32-bit PCI slots and
	  "Arcadia V3.1" silk screened adjacent to the 32-bit PCI connectors.
endchoice

config PEX
	bool "PCI Express support"
	depends on PCI && MPC8548
	help
	  !!!!!!!!!! WARNING !!!!!!!!!!
	  Enables Support for PCI Express
	  This requires hardware modification to work correctly
	  and will BREAK the PCI bus
	  Please contact Freescale for details
	  Thank You
	  !!!!!!!!!! WARNING !!!!!!!!!!

config PPC_GEN550
	bool
	depends on MPC8540 || SBC8560 || MPC8555
	default y

endmenu
```

## arch/ppc/platforms/86xx/Kconfig
```kconfig
config 86xx
	bool
	depends on 6xx

config PPC_OPENPIC_BE
	bool
	depends on 86xx
	default y

config PPC_INDIRECT_PCI_BE
	bool
	depends on 86xx
	default y

config PCIE
	bool "PCI Express support"
	depends on PCI && 86xx
	default y

config PPC_STD_MMU
	bool
	depends on 86xx
	default y

menu "Freescale 86xx Options"
	depends on 86xx

#we can specify 86xx chips here
config MPC8641
	bool
	depends on MPC8641_HPCN
	default y

config PPC_GEN550
	bool
	depends on MPC8641
	default y

endmenu
```

## arch/ppc/qe_io/.svn/text-base/Kconfig.svn-base
```kconfig
#
# QE Communication options
#

menu "QE Options"
	depends on QE

	source arch/ppc/qe_io/ucc/Kconfig
endmenu
```

## arch/ppc/qe_io/ucc/.svn/text-base/Kconfig.svn-base
```kconfig
#
# QE UCC options
#

config UCC1
	bool "Enable QE UCC1"

choice
	prompt "UCC1 speed selection"
	depends on UCC1
	default UCC1_SLOW

	config UCC1_SLOW
		bool "UCC1 is slow"
	config UCC1_FAST
		bool "UCC1 is fast"
endchoice

menu "UCC1 Protocols options"
	depends on UCC1

	choice
		prompt "UCC1 Slow Protocols selection"
		depends on UCC1_SLOW
		default UCC1_UART

		config UCC1_UART
			bool "UCC1 is UART"
	endchoice

	choice
		prompt "UCC1 Fast Protocols selection"
		depends on UCC1_FAST
		default UCC1_GETH

		config UCC1_GETH
			bool "UCC1 is GETH"
	endchoice
endmenu

config UCC2
	bool "Enable QE UCC2"

choice
	prompt "UCC2 speed selection"
	depends on UCC2
	default UCC2_SLOW

	config UCC2_SLOW
		bool "UCC2 is slow"
	config UCC2_FAST
		bool "UCC2 is fast"
endchoice

menu "UCC2 Protocols options"
	depends on UCC2

	choice
		prompt "UCC2 Slow Protocols selection"
		depends on UCC2_SLOW
		default UCC2_UART

		config UCC2_UART
			bool "UCC2 is UART"
	endchoice

	choice
		prompt "UCC2 Fast Protocols selection"
		depends on UCC2_FAST
		default UCC2_GETH

		config UCC2_GETH
			bool "UCC2 is GETH"
	endchoice
endmenu

config UCC3
	bool "Enable QE UCC3"

choice
	prompt "UCC3 speed selection"
	depends on UCC3
	default UCC3_SLOW

	config UCC3_SLOW
		bool "UCC3 is slow"
	config UCC3_FAST
		bool "UCC3 is fast"
endchoice

menu "UCC3 Protocols options"
	depends on UCC3

	choice
		prompt "UCC3 Slow Protocols selection"
		depends on UCC3_SLOW
		default UCC3_UART

		config UCC3_UART
			bool "UCC3 is UART"
        endchoice

	choice
		prompt "UCC3 Fast Protocols selection"
		depends on UCC3_FAST
		default UCC3_GETH

		config UCC3_GETH
			bool "UCC3 is GETH"
	endchoice
endmenu

config UCC4
	bool "Enable QE UCC4"

choice
	prompt "UCC4 speed selection"
	depends on UCC4
	default UCC4_SLOW

	config UCC4_SLOW
		bool "UCC4 is slow"
	config UCC4_FAST
		bool "UCC4 is fast"
endchoice

menu "UCC4 Protocols options"
	depends on UCC4

	choice
		prompt "UCC4 Slow Protocols selection"
		depends on UCC4_SLOW
		default UCC4_UART

		config UCC4_UART
			bool "UCC4 is UART"
	endchoice

	choice
		prompt "UCC4 Fast Protocols selection"
		depends on UCC4_FAST
		default UCC4_GETH

		config UCC4_GETH
			bool "UCC4 is GETH"
	endchoice
endmenu

config UCC5
	bool "Enable QE UCC5"

choice
	prompt "UCC5 speed selection"
	depends on UCC5
	default UCC5_SLOW

	config UCC5_SLOW
		bool "UCC5 is slow"
	config UCC5_FAST
		bool "UCC5 is fast"
endchoice

menu "UCC5 Protocols options"
	depends on UCC5

	choice
		prompt "UCC5 Slow Protocols selection"
		depends on UCC5_SLOW
		default UCC5_UART

		config UCC5_UART
			bool "UCC5 is UART"
	endchoice

	choice
		prompt "UCC5 Fast Protocols selection"
		depends on UCC5_FAST
		default UCC5_GETH

		config UCC5_GETH
			bool "UCC5 is GETH"
	endchoice
endmenu

config UCC6
	bool "Enable QE UCC6"

choice
	prompt "UCC6 speed selection"
	depends on UCC6
	default UCC6_SLOW

	config UCC6_SLOW
		bool "UCC6 is slow"
	config UCC6_FAST
		bool "UCC6 is fast"
endchoice

menu "UCC6 Protocols options"
	depends on UCC6

	choice
		prompt "UCC6 Slow Protocols selection"
		depends on UCC6_SLOW
		default UCC6_UART

		config UCC6_UART
			bool "UCC6 is UART"
	endchoice

	choice
		prompt "UCC6 Fast Protocols selection"
		depends on UCC6_FAST
		default UCC6_GETH

		config UCC6_GETH
			bool "UCC6 is GETH"
	endchoice
endmenu

config UCC7
	bool "Enable QE UCC7"

choice
	prompt "UCC7 speed selection"
	depends on UCC7
	default UCC7_SLOW

	config UCC7_SLOW
		bool "UCC7 is slow"
	config UCC7_FAST
		bool "UCC7 is fast"
endchoice

menu "UCC7 Protocols options"
	depends on UCC7

	choice
		prompt "UCC7 Slow Protocols selection"
		depends on UCC7_SLOW
		default UCC7_UART

		config UCC7_UART
			bool "UCC7 is UART"
	endchoice

	choice
		prompt "UCC7 Fast Protocols selection"
		depends on UCC7_FAST
		default UCC7_GETH

		config UCC7_GETH
			bool "UCC7 is GETH"
	endchoice
endmenu

config UCC8
	bool "Enable QE UCC8"

choice
	prompt "UCC8 speed selection"
	depends on UCC8
	default UCC8_SLOW

	config UCC8_SLOW
		bool "UCC8 is slow"
	config UCC8_FAST
		bool "UCC8 is fast"
endchoice

menu "UCC8 Protocols options"
	depends on UCC8

	choice
		prompt "UCC8 Slow Protocols selection"
		depends on UCC8_SLOW
		default UCC8_UART

		config UCC8_UART
			bool "UCC8 is UART"
	endchoice

	choice
		prompt "UCC8 Fast Protocols selection"
		depends on UCC8_FAST
		default UCC8_GETH

		config UCC8_GETH
			bool "UCC8 is GETH"
	endchoice
endmenu

config UCC
	depends on UCC1 || UCC2 || UCC3 || UCC4 || UCC5 || UCC6 || UCC7 || UCC8
	default y
	bool

config UCC_SLOW
	depends on UCC1_SLOW || UCC2_SLOW || UCC3_SLOW || UCC4_SLOW || UCC5_SLOW || UCC6_SLOW || UCC7_SLOW || UCC8_SLOW
	default y
	bool

config UCC_FAST
	depends on UCC1_FAST || UCC2_FAST || UCC3_FAST || UCC4_FAST || UCC5_FAST || UCC6_FAST || UCC7_FAST || UCC8_FAST
	default y
	bool

config UCC_GETH
	depends on UCC1_GETH || UCC2_GETH || UCC3_GETH || UCC4_GETH || UCC5_GETH || UCC6_GETH || UCC7_GETH || UCC8_GETH
	default y
	bool

config UGETH_NAPI
	depends on UCC_GETH
	bool "UCC GETH NAPI support"
```
