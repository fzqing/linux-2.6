## arch/sh/.svn/text-base/Kconfig.debug.svn-base
```kconfig
menu "Kernel hacking"

source "lib/Kconfig.debug"

config SH_STANDARD_BIOS
	bool "Use LinuxSH standard BIOS"
	help
	  Say Y here if your target has the gdb-sh-stub
	  package from www.m17n.org (or any conforming standard LinuxSH BIOS)
	  in FLASH or EPROM.  The kernel will use standard BIOS calls during
	  boot for various housekeeping tasks (including calls to read and
	  write characters to a system console, get a MAC address from an
	  on-board Ethernet interface, and shut down the hardware).  Note this
	  does not work with machines with an existing operating system in
	  mask ROM and no flash (WindowsCE machines fall in this category).
	  If unsure, say N.

config EARLY_SCIF_CONSOLE
	bool "Use early SCIF console"
	depends on CPU_SH4

config EARLY_PRINTK
	bool "Early printk support"
	depends on SH_STANDARD_BIOS || EARLY_SCIF_CONSOLE
	help
	  Say Y here to redirect kernel printk messages to the serial port
	  used by the SH-IPL bootloader, starting very early in the boot
	  process and ending when the kernel's serial console is initialised.
	  This option is only useful porting the kernel to a new machine,
	  when the kernel may crash or hang before the serial console is
	  initialised. If unsure, say N.
endmenu
```

## drivers/i2c/algos/Kconfig
```kconfig
#
# Character device configuration
#

menu "I2C Algorithms"
	depends on I2C

config I2C_ALGOBIT
	tristate "I2C bit-banging interfaces"
	depends on I2C
	help
	  This allows you to use a range of I2C adapters called bit-banging
	  adapters.  Say Y if you own an I2C adapter belonging to this class
	  and then say Y to the specific driver for you adapter below.

	  This support is also available as a module.  If so, the module 
	  will be called i2c-algo-bit.

config I2C_ALGOPCF
	tristate "I2C PCF 8584 interfaces"
	depends on I2C
	help
	  This allows you to use a range of I2C adapters called PCF adapters.
	  Say Y if you own an I2C adapter belonging to this class and then say
	  Y to the specific driver for you adapter below.

	  This support is also available as a module.  If so, the module 
	  will be called i2c-algo-pcf.

config I2C_ALGOPCA
	tristate "I2C PCA 9564 interfaces"
	depends on I2C
	help
	  This allows you to use a range of I2C adapters called PCA adapters.
	  Say Y if you own an I2C adapter belonging to this class and then say
	  Y to the specific driver for you adapter below.

	  This support is also available as a module.  If so, the module 
	  will be called i2c-algo-pca.

config I2C_ALGOPALM
	tristate "PalmChip's I2C interfaces"
	depends on I2C
	help
	  This allows you to use the BK3220 I2C Host Adapter on the RMI Phoenix.
	  This support is also available as a module.  If so, the module
	  will be called i2c-algo-palm.

config I2C_ALGOITE
	tristate "ITE I2C Algorithm"
	depends on MIPS_ITE8172 && I2C
	help
	  This supports the use of the ITE8172 I2C interface found on some MIPS
	  systems. Say Y if you have one of these. You should also say Y for
	  the ITE I2C peripheral driver support below.

	  This support is also available as a module.  If so, the module 
	  will be called i2c-algo-ite.

config I2C_ALGO8XX
	tristate "MPC8xx CPM I2C interface"
	depends on 8xx && I2C

config I2C_ALGO_SIBYTE
	tristate "SiByte SMBus interface"
	depends on SIBYTE_SB1xxx_SOC && I2C
	help
	  Supports the SiByte SOC on-chip I2C interfaces (2 channels).

config I2C_ALGO_SGI
	tristate "I2C SGI interfaces"
	depends on I2C
	help
	  Supports the SGI interfaces like the ones found on SGI Indy VINO
	  or SGI O2 MACE.

config I2C_ALGO_XILINX
	tristate "I2C IP from Xilinx EDK"
	depends on XILINX_VIRTEX && I2C
	select XILINX_EDK
	help
	  Supports I2C IP from Xilinx EDK.

config I2C_ALGO_EMMA2RH
	tristate "I2C EMMA2RH interfaces"
	depends on I2C && MARKEINS
	help
	  NEC EMMA2RH I2C Algorithm
endmenu
```

## drivers/input/keyboard/.svn/text-base/Kconfig.svn-base
```kconfig
#
# Input core configuration
#
config INPUT_KEYBOARD
	bool "Keyboards" if EMBEDDED || !X86
	default y
	depends on INPUT
	help
	  Say Y here, and a list of supported keyboards will be displayed.
	  This option doesn't affect the kernel.

	  If unsure, say Y.

config KEYBOARD_ATKBD
	tristate "AT keyboard support" if !PC
	default y
	depends on INPUT && INPUT_KEYBOARD
	select SERIO
	select SERIO_I8042 if PC
	select SERIO_GSCPS2 if GSC
	help
	  Say Y here if you want to use a standard AT or PS/2 keyboard. Usually
	  you'll need this, unless you have a different type keyboard (USB, ADB
	  or other). This also works for AT and PS/2 keyboards connected over a
	  PS/2 to serial converter.

	  If unsure, say Y.

	  To compile this driver as a module, choose M here: the
	  module will be called atkbd.

config KEYBOARD_SUNKBD
	tristate "Sun Type 4 and Type 5 keyboard support"
	depends on INPUT && INPUT_KEYBOARD
	select SERIO
	help
	  Say Y here if you want to use a Sun Type 4 or Type 5 keyboard,
	  connected either to the Sun keyboard connector or to an serial
	  (RS-232) port via a simple adapter.

	  To compile this driver as a module, choose M here: the
	  module will be called sunkbd.

config KEYBOARD_LKKBD
	tristate "DECstation/VAXstation LK201/LK401 keyboard support"
	depends on INPUT && INPUT_KEYBOARD
	select SERIO
	help
	  Say Y here if you want to use a LK201 or LK401 style serial
	  keyboard. This keyboard is also useable on PCs if you attach
	  it with the inputattach program. The connector pinout is
	  described within lkkbd.c.

	  To compile this driver as a module, choose M here: the
	  module will be called lkkbd.

config KEYBOARD_XTKBD
	tristate "XT Keyboard support"
	depends on INPUT && INPUT_KEYBOARD
	select SERIO
	help
	  Say Y here if you want to use the old IBM PC/XT keyboard (or
	  compatible) on your system. This is only possible with a
	  parallel port keyboard adapter, you cannot connect it to the
	  keyboard port on a PC that runs Linux.

	  To compile this driver as a module, choose M here: the
	  module will be called xtkbd.

config KEYPAD_ZYLONITE
	tristate "Zylonite Keypad"
	depends on INPUT && INPUT_KEYBOARD && MACH_ZYLONITE
	default y
	help
	   Say Y to support the zylonite board keypad.

config KEYPAD_ZYLONITE_REPEATKEY
	bool "Zylonite Keypad Repeat Key support"
	depends on KEYPAD_ZYLONITE
	default y
	help
	   Say Y to support the zylonite board keypad repeat key.

config KEYPAD_ZYLONITE_COMBOKEY
	bool "Zylonite Keypad Combo Key support"
	depends on KEYPAD_ZYLONITE
	default y
	help
	   Say Y to support the zylonite board keypad combo key.
	   Maxium TWO keys could be pressed simultaneously.

config KEYPAD_ZYLONITE_SHIFT
	bool "Zylonite Keypad Shift Key support"
	depends on KEYPAD_ZYLONITE
	default n
	help
	   Say Y to support the zylonite board keypad shift key.

config KEYBOARD_NEWTON
	tristate "Newton keyboard"
	depends on INPUT && INPUT_KEYBOARD
	select SERIO
	help
	  Say Y here if you have a Newton keyboard on a serial port.

	  To compile this driver as a module, choose M here: the
	  module will be called newtonkbd.

config KEYBOARD_MAPLE
	tristate "Maple bus keyboard support"
	depends on SH_DREAMCAST && INPUT && INPUT_KEYBOARD && MAPLE
	help
	  Say Y here if you have a DreamCast console running Linux and have
	  a keyboard attached to its Maple bus.

	  To compile this driver as a module, choose M here: the
	  module will be called maple_keyb.

config KEYBOARD_AMIGA
	tristate "Amiga keyboard"
	depends on AMIGA && INPUT && INPUT_KEYBOARD
	help
	  Say Y here if you are running Linux on any AMIGA and have a keyboard
	  attached.

	  To compile this driver as a module, choose M here: the
	  module will be called amikbd.

config KEYBOARD_OMAP
	tristate "TI OMAP keypad support"
        depends on ARCH_OMAP && INPUT && INPUT_KEYBOARD
        help
	  Say Y here if you want to use the OMAP keypad. 

	  To compile this driver as a module, choose M here: the
	  module will be called omap-keypad.

config OMAP_PS2
	tristate "TI OMAP Innovator 1510 PS/2 keyboard & mouse support"
	depends on ARCH_OMAP1510 && MACH_OMAP_INNOVATOR && INPUT && INPUT_KEYBOARD
	help
	  Say Y here if you want to use the OMAP Innovator 1510 PS/2
	  keyboard and mouse.

	  To compile this driver as a module, choose M here: the
	  module will be called innovator_ps2.
	  
config KEYBOARD_MAINSTONE
	tristate "Intel Mainstone (HCDDBBVA0) keypad support"
	depends on MACH_MAINSTONE
	help
	  Say Y here if you want to use the Mainstone keypad.
	  
```
