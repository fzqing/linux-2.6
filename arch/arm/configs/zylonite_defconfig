## arch/arm/mach-davinci/Kconfig
```kconfig
if ARCH_DAVINCI

menu "TI DaVinci Implementations"

comment "DaVinci Core Type"

choice
	prompt "DaVinci ARCH type"
	default ARCH_DAVINCI_DM644x

config ARCH_DAVINCI_DM644x
	bool "DaVinci 644x based system"

config ARCH_DAVINCI_DM355
	bool "DaVinci DM355 based system"

config ARCH_DAVINCI_DM646x
	bool "DaVinci 646x based system"
endchoice

comment "DaVinci Board Type"

config MACH_DAVINCI_EVM
	bool "TI DaVinci EVM"
	default y
	depends on ARCH_DAVINCI_DM644x
	help
	  Configure this option to specify the whether the board used
	  for development is a DaVinci EVM

config MACH_DAVINCI_DM355_EVM
	bool "TI DM355 EVM"
	default n
	depends on ARCH_DAVINCI_DM355
	help
	  Configure this option to specify the whether the board used
	  for development is a DM355 EVM

config MACH_DAVINCI_HD_EVM
	bool "TI DaVinci HD EVM"
	default n
	depends on ARCH_DAVINCI_DM646x && !ARCH_DAVINCI_DM644x
	help
	  Configure this option to specify the whether the board used
	  for development is a DaVinci HD EVM

config DAVINCI_I2C_EXPANDER
	bool "TI DaVinci I2C Expander"
	default y
	depends on ARCH_DAVINCI_DM644x || ARCH_DAVINCI_DM646x || ARCH_DAVINCI_DM355
	select I2C_DAVINCI
	help
	  Configure this option to specify whether the board used
	  has I2C exapnder with ATA, USB, CF.

config DAVINCI_MUX
	bool "DAVINCI multiplexing support"
	depends on ARCH_DAVINCI
	default y
	help
	  Pin multiplexing support for DAVINCI boards. If your bootloader
	  sets the multiplexing correctly, say N. Otherwise, or if unsure,
	  say Y.

config DAVINCI_MUX_DEBUG
	bool "Multiplexing debug output"
	depends on DAVINCI_MUX
	help
	  Makes the multiplexing functions print out a lot of debug info.
	  This is useful if you want to find out the correct values of the
	  multiplexing registers.

config DAVINCI_MUX_WARNINGS
	bool "Warn about pins the bootloader didn't set up"
	depends on DAVINCI_MUX
	default y
	help
	  Choose Y here to warn whenever driver initialization logic needs
	  to change the pin multiplexing setup.  When there are no warnings
	  printed, it's safe to deselect DAVINCI_MUX for your product.

config DAVINCI_MCBSP
	bool
	prompt "DaVinci McBSP Driver" if SOUND_DAVINCI=y && ARCH_DAVINCI_DM646x=n
	depends on ARCH_DAVINCI
	default y if SOUND_DAVINCI
	---help---
	DaVinci McBSP driver.  Auto-enabled by DaVinci sound driver.

config DAVINCI_MCASP
	bool 
	prompt "DaVinci HD McASP Driver" if SOUND_DAVINCI_HD=y && ARCH_DAVINCI_DM644x=n
	depends on ARCH_DAVINCI && ARCH_DAVINCI_DM646x
	default y if SOUND_DAVINCI_HD
	---help---
	DaVinci HD McASP driver.  Auto-enabled by DaVinci HD sound driver.

comment "DaVinci Options"

config DAVINCI_BLK_DEV_CF
	bool "TI DaVinci CF Card Support"
	default Y
	depends on BLK_DEV_DAVINCI
	help
	  Configure this option to enable CF Card support.

config DM355_NAND_256KB_BLOCKS
	bool "NAND chip installed on DM355 EVM has 256KB blocks"
	default y
	depends on MACH_DAVINCI_DM355_EVM
	help
	The boot firmware on the DM355 EVM assumes a default partition map
	for NAND flash based on erase block offsets.  Thus, the partition map
	varies based on the size of the erase blocks in the particular NAND
	flash component installed on the board.  Answer Y here if the NAND
	chip (e.g a 16 Gigabit Micron MT29F16G08QAA) installed on your board
	has 256KB blocks.  Answer N here if the NAND chip (e.g. a 4 Gigabit
	Micron MT29F4G08AAA) installed on your board has 128KB blocks.

config DAVINCI_SPI
	bool "TI DAVINCI SPI device"
	default y
	help
	Configure this option to specify whether the board used
	has SPI device.

choice
	prompt "Low-level debug console UART"
	default DAVINCI_LL_DEBUG_UART0

config DAVINCI_LL_DEBUG_UART0
	bool "UART0"

config DAVINCI_LL_DEBUG_UART1
	bool "UART1"

endchoice

endmenu

endif
```

## arch/arm/mach-pxa/.svn/text-base/Kconfig.svn-base
```kconfig
if ARCH_PXA

menu "Intel PXA2xx Implementations"

choice
	prompt "Select target board"

config ARCH_LUBBOCK
	bool "Intel DBPXA250 Development Platform"
	select PXA25x

config MACH_MAINSTONE
	bool "Intel HCDDBBVA0 Development Platform"
	select PXA27x
	select IWMMXT

config ARCH_PXA_IDP
	bool "Accelent Xscale IDP"
	select PXA25x


config MACH_ZYLONITE
	bool "Zylonite Development Platform"
	select PXA3xx
	select IWMMXT
	select CPU_XSC3

endchoice

endmenu

config PXA25x
	bool
	help
	  Select code specific to PXA21x/25x/26x variants

config PXA27x
	bool
	help
	  Select code specific to PXA27x variants

config PXA3xx
	bool
	help
	  Select code specific to Intel(R) processor PXA3xx variants

menu "Marvell PXA3xx Implementations"

choice
	prompt "Select code specific to Marvell(R) processor PXA3xx variants"

config PXA300
	bool "Marvell(R) PXA300 Processor"
	depends on PXA3xx
	help
	  Support for Marvell(R) PXA300 Processor
	  formerly code-named L Processor

config PXA310
	bool "Marvell(R) PXA310 Processor"
	depends on PXA3xx
	help
	  Support for Marvell(R) PXA310 Processor
	  formerly code-named LV Processor

endchoice

endmenu

config IWMMXT
	bool
	help
	  Enable support for iWMMXt

config PXA3xx_PMIC
 	bool
 	help
 	  PMIC support

endif
```

## arch/mips/mips-boards/ti_avalanche/Kconfig
```kconfig
menu "Avalanche SoC Common Options"

#
# Configuration options common to all avalanche series processors come here.
#
config CPU_FREQUENCY_AVALANCHE
	depends on MIPS_AVALANCHE_SOC
	int "Avalanche SoC CPU frequency (MHz)"
	default 125
	help
      Choose the default value here. The correct value will be read from
      the bootloader environment variables.

config MEMORY_START
	depends on MIPS_AVALANCHE_SOC
	hex "Avalanche SoC SDRAM start" 
	default 0x14000000
	help
      Choose the default value here. Unless you really know what you are
      doing.

config MIPS_AVALANCHE_LOAD_ADDRESS
	depends on MIPS_AVALANCHE_SOC
	hex "Avalanche SoC Linux Load address" 
	default 0xFFFFFFFF94020000
	help
      The default value should be good for most cases. Choose a value
      higher than the default if you are using more memory at the bottom
      than what the bootloader uses. Choosing a lesser value than the 
      default is strictly discouraged. You will most likely mess with
      the boot process. 

config MIPS_AVALANCHE_PSPBOOT
	depends on MIPS_AVALANCHE_SOC
	bool "Avalanche SoC PSPBoot Support" 
	default y
	help
      Choose Y here if PSPBoot is your bootloader. If you are using Adam2
      or any other bootloader, choose N. If unsure, contact your software
      vendor.

config MIPS_AVALANCHE_FREE_BOOTMEM
	depends on MIPS_AVALANCHE_SOC
	def_bool n if MIPS_AVALANCHE_ADAM2_JMP_TBL    
	bool "Free the memory occupied by bootloader"  if MIPS_AVALANCHE_PSPBOOT
	default y
	help
      Saying yes here will free-up the memory from (SDRAM base + 4K) to
      the start of linux text section. 
    
config AVALANCHE_SERIAL_AUTOFLOW 
	depends on MIPS_AVALANCHE_S0C
	bool "Avalanche Serial autoflow"
	default y
	help
      Choose Y here if you want to enable Auto flow control on Avalanche
      serial device. In unsure choose Y.

config MIPS_AVALANCHE_INTC 
	def_bool MIPS_AVALANCHE_SOC

#
# Get to know which specific SoC type the user wants to compile for.
#
choice
	prompt "TI BroadBand SOC Type (Avalanche Series)"
	depends on MIPS_AVALANCHE_SOC
	help
      Select the TI BoardBand SoC Type that you want the kernel port for. If
      unsure, contact your software vendor.
 
config MIPS_TITAN
	bool "TI MIPS TITAN (aka TNETV1050 or TNETV1060)"


endchoice

if MIPS_TITAN
    source "arch/mips/mips-boards/ti_avalanche/ti_titan/Kconfig"   
endif

endmenu
```

## arch/mips/mips-boards/ti_avalanche/ti_titan/Kconfig
```kconfig
menu "TI Titan (TNETV1050) Configuration"

choice
	prompt "Titan reference board type"
	depends on MIPS_TITAN
	help
      Select the Titan Ref. Design Board that you are using. If you are not 
      using any of these, choose the one closest to your design and make 
      modifications to the kernel as required.

config MIPS_TNETV1050RDB
	depends on MIPS_TITAN
	bool "Titan RDB Board"

config MIPS_TNETV1050SDB
	depends on MIPS_TITAN
	bool "Titan SDB Board"

endchoice

config MIPS_AVALANCHE_CPMAC
	tristate "Texas Instruments Avalanche CPMAC support"       
    default m
    help
      Choose y/m, to compile the TI Avalanche CPMAC driver.

config MIPS_CPMAC_PORTS
    int
	range 1 2
    depends on MIPS_AVALANCHE_CPMAC
	default 2 if MIPS_TNETV1050SDB || MIPS_TNETV1050RDB 

config AVALANCHE_LOW_CPMAC	
	bool
    depends on MIPS_AVALANCHE_CPMAC
    default y if MIPS_TNETV1050SDB || MIPS_TNETV1050RDB

config AVALANCHE_HIGH_CPMAC
	bool
    depends on MIPS_AVALANCHE_CPMAC
	default y if MIPS_TNETV1050SDB || MIPS_TNETV1050RDB

config MIPS_CPMAC_INIT_BUF_MALLOC
        bool "CPMAC Init Buffer Malloc"
        depends on MIPS_AVALANCHE_CPMAC
        default y

config MIPS_AVALANCHE_SSP
	bool "Avalanche SSP support"
	default y
	help
	 Choose y to compile the Avalanche SSP driver.

config AVALANCHE_NUM_SER_PORTS
	depends on MIPS_AVALANCHE_SOC
	int
	default 1
	help
      Choose the correct number of serial ports on your soc here. If unsure
      consult the SoC specification from your vendor, but do not put a 
      wrong value here.

config AVALANCHE_CONSOLE_PORT
	depends on MIPS_AVALANCHE_SOC
    int
	default 0
	help
      Choose the Avalanche serial port number functioning as the ttyS0 (console)
      port. The valid values range from 0 through AVALANCHE_NUM_SER_PORTS - 1.

endmenu
```

## arch/mips/rmi/Kconfig
```kconfig
config PHOENIX_PSB
	bool 
	default y

config RMI_PTR
	bool
	default y

config PHOENIX_SMP_PREFIX
	bool 'Support for printk SMP prefix'
	depends on RMI_PHOENIX
	help
	Selecting this option will result in prefixing of kernel printk's by
	the logical CPU ID.

config PHOENIX_MAC
	bool 'Support for On-Chip MAC'
	depends on RMI_PHOENIX
	help
	Selecting this option will enable support for on-chip 1G MACs.

config PHOENIX_USER_MAC
	bool 'Support for User Mac'
	depends on PHOENIX_MAC

config PHOENIX_SPI4
	bool 'Support for on-chip SPI4 interfaces'
	depends on RMI_PHOENIX
	help
	With the Vitesse SPI4 daughter card, this driver will abstract the 
	20 SPI4 channels as Gigabit ethernet interfaces.

config PHOENIX_DMA
	bool 'Support for On-Chip DMA Engine'
	depends on RMI_PHOENIX
	default n
	help
	Selecting this option will enable support for XLR DMA engine. 

config PHOENIX_DMA_PAGEOPS
	bool 'Support for Copy page using DMA engine'
	depends on PHOENIX_DMA
	default n
	help
	Selecting this option will enable copy_page to use DMA instead of 
	CPU copy.

config PHOENIX_TRACEBUFFER
	bool 'Driver for capturing tracebuffer contents'
	depends on RMI_PHOENIX
	help
	With the help of this driver and a simple application, one can capture
	tracebuffer FIFO contents into a file. Sample application is 
	provided in apps/tracebuffer

config PHOENIX_EARLY_PRINTK
	bool 'Support for Early printk'
	depends on RMI_PHOENIX
	default y
	help
	Selecting this option will enable output of kernel log messages on
	the serial console before the actual serial port driver is loaded.

config PHOENIX_FAST_CSUM
	bool 'Support for Fast Checksum using DADDWC'
	depends on RMI_PHOENIX
	default y
	help
	Selecting this option will enable checksum(TCP) computations using XLR
	specific daddwc instruction. This will double the speed of checksum
	computations.
```

## arch/mips/tx4939/Kconfig
```kconfig
comment "Multiplex Pin Select"


choice
	prompt "GPIO[04:09] ACLINK or I2S"
	default TOSHIBA_TX4939_MPLEX_GPIO04_09
config TOSHIBA_TX4939_MPLEX_GPIO04_09
	bool "GPIO"
config TOSHIBA_TX4939_MPLEX_ACLINK
	bool "ACLINK"
config TOSHIBA_TX4939_MPLEX_I2S
	bool "I2S"
endchoice


choice
	prompt "GPIO[10:11] I2C"
	default TOSHIBA_TX4939_MPLEX_GPIO10_11
config TOSHIBA_TX4939_MPLEX_GPIO10_11
	bool "GPIO"
config TOSHIBA_TX4939_MPLEX_I2C
	bool "I2C"
endchoice


choice
	prompt "GPIO[12:15] CTS/RTS or SIO2/3"
	default TOSHIBA_TX4939_MPLEX_GPIO12_15
config TOSHIBA_TX4939_MPLEX_GPIO12_15
	bool "GPIO"
config TOSHIBA_TX4939_MPLEX_SPI
	bool "SPI"
config TOSHIBA_TX4939_MPLEX_CTS_RTS
	bool "CTS/RTS"
config TOSHIBA_TX4939_MPLEX_SIO2
	bool "SIO2"
endchoice


choice
	prompt "G0PIO[00:29] ATA100-0"
	default TOSHIBA_TX4939_MPLEX_ATA0
config TOSHIBA_TX4939_MPLEX_G0PIO
	bool "GPIO"
config TOSHIBA_TX4939_MPLEX_ATA0
	bool "ATA100-0"
endchoice


choice
	prompt "G1PIO[00:29] ATA100-1 or Ether"
	default TOSHIBA_TX4939_MPLEX_ETHER
config TOSHIBA_TX4939_MPLEX_G1PIO
	bool "GPIO"
config TOSHIBA_TX4939_MPLEX_ATA1
	bool "ATA100-1"
config TOSHIBA_TX4939_MPLEX_ETHER
	bool "ETHER"
endchoice


choice
	prompt "G2PIO[00:16] Video port"
	default TOSHIBA_TX4939_MPLEX_G2PIO
config TOSHIBA_TX4939_MPLEX_G2PIO
	bool "GPIO"
config TOSHIBA_TX4939_MPLEX_PC_TRACE
	bool "PC-Trace"
config TOSHIBA_TX4939_MPLEX_1PARALLEL_PORT
	bool "1-Parallel&GPIO"
config TOSHIBA_TX4939_MPLEX_3SERIAL_PORT
	bool "3-Serial&GPIO"
config TOSHIBA_TX4939_MPLEX_1PARALLEL_1SERIAL
	bool "1-Serial&1-Parallel"
endchoice


choice
	prompt "PCICLK[1:4] Reset"
	default TOSHIBA_TX4939_MPLEX_RESET
config TOSHIBA_TX4939_MPLEX_RESET
	bool "RESET"
config TOSHIBA_TX4939_MPLEX_PCICLKON
	bool "PCICLK"
endchoice


choice
	prompt "CIR or SIO3"
	default TOSHIBA_RBTX4939_PIN_CIR
config TOSHIBA_RBTX4939_PIN_CIR
	bool "CIR"
config TOSHIBA_RBTX4939_PIN_SIO3
	bool "SIO3"
endchoice
```

## arch/ppc/Kconfig.debug
```kconfig
menu "Kernel hacking"

source "lib/Kconfig.debug"

config XMON
	bool "Include xmon kernel debugger"
	depends on DEBUG_KERNEL
	help
	  Include in-kernel hooks for the xmon kernel monitor/debugger.
	  Unless you are intending to debug the kernel, say N here.

config DEBUGGER
	bool
	depends on KGDB || XMON
	default y

config BDI_SWITCH
	bool "Include BDI-2000 user context switcher"
	depends on DEBUG_KERNEL
	help
	  Include in-kernel support for the Abatron BDI2000 debugger.
	  Unless you are intending to debug the kernel with one of these
	  machines, say N here.

config BOOTX_TEXT
	bool "Support for early boot text console (BootX or OpenFirmware only)"
	depends PPC_OF
	help
	  Say Y here to see progress messages from the boot firmware in text
	  mode. Requires either BootX or Open Firmware.

config SERIAL_TEXT_DEBUG
	bool "Support for early boot texts over serial port"
	depends on 4xx || GT64260 || LOPEC || PPLUS || PRPMC800 || \
	        PPC_GEN550 || PPC_MPC52xx || PRPMC275 || MPC8641_HPCN || TAIGA

config PPC_OCP
	bool
	depends on IBM_OCP || FSL_OCP || XILINX_OCP
	default y

endmenu
```
