## drivers/usb/musb/.svn/text-base/Kconfig.svn-base
```kconfig
#
# USB Dual Role (OTG-ready) Controller Drivers
# for silicon based on Mentor Graphics INVENTRA designs
#

comment "Enable Host or Gadget support to see Inventra options"
	depends on !USB && USB_GADGET=n

# (M)HDRC = (Multipoint) Highspeed Dual-Role Controller
config USB_MUSB_HDRC
	depends on USB || USB_GADGET
	tristate 'Inventra USB Highspeed Dual Role Controller Support'
	help
	  Say Y here if your system has a dual role high speed USB
	  controller based on the Mentor Graphics silicon IP.  Then
	  configure options to match your silicon and the board
	  it's being used with, including the USB peripheral role,
	  or the USB host role, or both.

	  Texas Instruments parts using this IP include DaVinci 644x,
	  OMAP 2430, OMAP 3430, and TUSB 6010.

	  If you do not know what this is, please say N.

	  To compile this driver as a module, choose M here; the
	  module will be called "musb_hdrc".

config USB_MUSB_SOC
	boolean
	depends on USB_MUSB_HDRC
	default y if ARCH_DAVINCI
	default y if ARCH_OMAP2430
	default y if ARCH_OMAP3430

comment "DaVinci 644x USB support"
	depends on USB_MUSB_HDRC && ARCH_DAVINCI

comment "OMAP 2430 high speed USB support"
	depends on USB_MUSB_HDRC && ARCH_OMAP2430

comment "OMAP 3430 high speed USB support"
	depends on USB_MUSB_HDRC && ARCH_OMAP3430

config USB_TUSB_6010
	boolean "TUSB 6010 support"
	depends on USB_MUSB_HDRC && !USB_MUSB_SOC
	help
	  The TUSB 6010 chip, from Texas Instruments, connects a discrete
	  HDRC core using a 16-bit parallel bus (NOR flash style) or
	  VLYNQ.

choice
	prompt "Driver Mode"
	depends on USB_MUSB_HDRC
	help
	  Dual-Role devices can support both host and peripheral roles,
	  as well as a the special "OTG Device" role which can switch
	  between both roles as needed.

# use USB_MUSB_HDRC_HCD not USB_MUSB_HOST to #ifdef host side support;
# OTG needs both roles, not just USB_MUSB_HOST.
config USB_MUSB_HOST
	depends on USB
	bool "USB Host"
	help
	  Say Y here if your system supports the USB host role.
	  If it has a USB "A" (rectangular), "Mini-A" (uncommon),
	  or "Mini-AB" connector, it supports the host role.
	  (With a "Mini-AB" connector, you should enable USB OTG.)

# use USB_GADGET_MUSB_HDRC not USB_MUSB_PERIPHERAL to #ifdef peripheral
# side support ... OTG needs both roles
config USB_MUSB_PERIPHERAL
	depends on USB_GADGET
	bool "USB Peripheral (gadget stack)"
	select USB_GADGET_MUSB_HDRC
	help
	  Say Y here if your system supports the USB peripheral role.
	  If it has a USB "B" (squarish), "Mini-B", or "Mini-AB"
	  connector, it supports the peripheral role.
	  (With a "Mini-AB" connector, you should enable USB OTG.)

config USB_MUSB_OTG
	depends on USB && USB_GADGET && EXPERIMENTAL && !ARCH_DAVINCI_DM646x
	bool "Both host and peripheral:  USB OTG (On The Go) Device"
	select USB_GADGET_MUSB_HDRC
	select USB_OTG
	select PM
	help
	   The most notable feature of USB OTG is support for a
	   "Dual-Role" device, which can act as either a device
	   or a host.  The initial role choice can be changed
	   later, when two dual-role devices talk to each other.

	   At this writing, the OTG support in this driver is incomplete,
	   omitting the mandatory HNP or SRP protocols.  However, some
	   of the cable based role switching works.  (That is, grounding
	   the ID pin switches the controller to host mode, while leaving
	   it floating leaves it in peripheral mode.)

	   Select this if your system has a Mini-AB connector, or
	   to simplify certain kinds of configuration.

	   To implement your OTG Targeted Peripherals List (TPL), enable
	   USB_OTG_WHITELIST and update "drivers/usb/core/otg_whitelist.h"
	   to match your requirements.

endchoice

config  MUSB_RESERVE_ISO_EP
	boolean "Reserve ISO EndPoints"
	depends on USB && USB_MUSB_HOST
	bool
	help
	   Say Y if your system needs to handle ISO devices such as Webcams,
	   USB audio devices etc.  If not say N.  If you select Y then a
	   Endpoint is reserved for handling ISO devices and will not be
	   available for handling other types of traffic such as BULK, INT.

# enable peripheral support (including with OTG)
config USB_GADGET_MUSB_HDRC
	bool
	depends on USB_MUSB_HDRC && (USB_MUSB_PERIPHERAL || USB_MUSB_OTG)
#	default y
#	select USB_GADGET_DUALSPEED
#	select USB_GADGET_SELECTED

# enables host support (including with OTG)
config USB_MUSB_HDRC_HCD
	bool
	depends on USB_MUSB_HDRC && (USB_MUSB_HOST || USB_MUSB_OTG)
	select USB_OTG if USB_GADGET_MUSB_HDRC
	default y


config USB_INVENTRA_FIFO
	bool 'Disable DMA (always use PIO)'
	depends on USB_MUSB_HDRC
	default n
	help
	  All data is copied between memory and FIFO by the CPU.
	  DMA controllers (from Mentor or otherwise) are ignored.

	  When DMA is enabled at compile time, you can still disable
	  it at run time using the "use_dma=n" module parameter.

config USB_INVENTRA_DMA
	bool
	depends on USB_MUSB_HDRC && !USB_INVENTRA_FIFO
	default ARCH_OMAP243X
	help
	  Enable DMA transfers using Mentor's engine.

config USB_TI_CPPI_DMA
	bool
	depends on USB_MUSB_HDRC && !USB_INVENTRA_FIFO
	default ARCH_DAVINCI
	help
	  Enable DMA transfers when TI CPPI DMA is available.

config USB_INVENTRA_STATIC_CONFIG
	bool
	depends on USB_MUSB_HDRC
	default USB_MUSB_SOC
	help
	  Use a static <asm/arch/hdrc_cnf.h> file to describe how the
	  controller is configured (endpoints, mechanisms, etc).

config	USB_INVENTRA_HCD_LOGGING
	depends on USB_MUSB_HDRC
	int  'Logging Level (0 - none / 3 - annoying / ... )'
	default 0
	help
	  Set the logging level. 0 disables the debugging altogether,
	  although when USB_DEBUG is set the value is at least 1.
	  Starting at level 3, per-transfer (urb, usb_request, packet,
	  or dma transfer) tracing may kick in.
```

## drivers/video/logo/Kconfig
```kconfig
#
# Logo configuration
#

menu "Logo configuration"

config LOGO
	bool "Bootup logo"
	depends on FB || SGI_NEWPORT_CONSOLE

config LOGO_LINUX_MONO
	bool "Standard black and white Linux logo"
	depends on LOGO
	default y

config LOGO_LINUX_VGA16
	bool "Standard 16-color Linux logo"
	depends on LOGO
	default y

config LOGO_LINUX_CLUT224
	bool "Standard 224-color Linux logo"
	depends on LOGO
	default y
endmenu
```

## fs/yaffs/Kconfig
```kconfig
#
# YAFFS file system configurations
#
config YAFFS1_FS
	tristate "YAFFS version 1 legacy implementation"
	help
	  Use obsolete YAFFS1 code.  Obsoleted by YAFFS2, which provides
	  YAFFS1 compatibility.

	  If unsure, say N.

	  Further information on YAFFS is available at
	  <http://www.aleph1.co.uk/yaffs/>.

config YAFFS1_MTD_ENABLED
	bool "NAND mtd support"
	depends on YAFFS1_FS
	help
	  This adds the yaffs file system support for working with a NAND mtd.

	  If unsure, say Y.

config YAFFS1_RAM_ENABLED
	bool "yaffsram file system support"
	depends on YAFFS1_FS
	help
	  This adds the yaffsram file system support. Nice for testing on x86,
	  but uses 2MB of RAM.  Don't enable for NAND-based targets.

	  If unsure, say N.

comment "WARNING: mtd and/or yaffsram support should be selected"
	depends on YAFFS1_FS && !YAFFS1_MTD_ENABLED && !YAFFS1_RAM_ENABLED

config YAFFS1_USE_OLD_MTD
	bool "Old mtd support"
	depends on YAFFS1_FS && 0
	help
	  Enable this to use the old MTD stuff that did not have yaffs support.
	  You can use this to get around compilation problems, but the best
	  thing to do is to upgrade your MTD support. You will get better speed.

	  If unsure, say N.

config YAFFS1_USE_NANDECC
	bool "Use ECC functions of the generic MTD-NAND driver"
	depends on YAFFS1_FS
	default y
	help
	  This enables the ECC functions of the generic MTD-NAND driver.
	  This will not work if you are using the old mtd.

	  NB Use NAND ECC does not work at present with yaffsram.

	  If unsure, say Y.

config YAFFS1_ECC_WRONG_ORDER
	bool "Use the same ecc byte order as Steven Hill's nand_ecc.c"
	depends on YAFFS1_FS
	help
	  This makes yaffs_ecc.c use the same ecc byte order as
	  Steven Hill's nand_ecc.c. If not set, then you get the
	  same ecc byte order as SmartMedia.

	  If unsure, say N.

config YAFFS1_USE_GENERIC_RW
	bool "Use Linux file caching layer"
	default y
	depends on YAFFS1_FS
	help
	  Use generic_read/generic_write for reading/writing files. This
	  enables the use of the Linux file caching layer.

	  If you disable this, then caching is disabled and file read/write
	  is direct.

	  If unsure, say Y.

config YAFFS1_USE_HEADER_FILE_SIZE
	bool "Use object header size"
	depends on YAFFS1_FS
	help
	  When the flash is scanned, two file sizes are constructed:
	  * The size taken from the object header for the file.
	  * The size figured out by scanning the data chunks.
	  If this option is enabled, then the object header size is used,
	  otherwise the scanned size is used.

	  If unsure, say N.

config YAFFS1_DISABLE_CHUNK_ERASED_CHECK
	bool "Turn off debug chunk erase check"
	depends on YAFFS1_FS
	default y
	help
	  Enabling this turns off the test that chunks are erased in flash
	  before writing to them.  This is safe, since the write verification
	  will fail.  Suggest enabling the test (ie. say N)
	  during development to help debug things.

	  If unsure, say Y.

#config YAFFS1_DISABLE_WRITE_VERIFY
#	bool "Disable write verify (DANGEROUS)"
#	depends on YAFFS1_FS && EXPERIMENTAL
#	help
#	  I am severely reluctant to provide this config. Disabling the
#	  verification is not a good thing to do since NAND writes can
#	  fail silently.  Disabling the write verification will cause your
#	  teeth to rot, rats to eat your corn and give you split ends.
#	  You have been warned. ie. Don't uncomment the following line.
#
#	  If unsure, say N.
#

config YAFFS1_SHORT_NAMES_IN_RAM
	bool "Cache short names in RAM"
	depends on YAFFS1_FS
	default y
	help
	  If this config is set, then short names are stored with the
	  yaffs_Object.  This costs an extra 16 bytes of RAM per object,
	  but makes look-ups faster.

	  If unsure, say Y.

 
```

## ktools/.svn/text-base/Kconfig.svn-base
```kconfig
menu "MontaVista System tools"

config XILINX_EDK
	bool
	depends on XILINX_VIRTEX
	default n

config ILATENCY
       bool "Interrupt Latency"
       depends on !CRITICAL_IRQSOFF_TIMING
       help
         This option turns on instrumentation in the kernel to measure the
         interrupt overhead and interrupt hold off times of the kernel and
         driver set for a particular system.  The measurement provides
         interrupt latency data to gain an understanding of what interrupt
         latencies look like for that system.

	 This instrumentation is mutually exclusive to CRITICAL_IRQSOFF_TIMING.
	 If you are analyzing interrupt latency and off times with DevRocket
	 you must use ILATENCY.

         The data is collected in /proc/ilatcurve, outlier data, or the
         maximum interrupt off offenders are collected in /proc/imaxoff.  This
         file has the longest interrupt off times and the file and line number
         of the interrupt off/on pair.  This file is useful for finding and
         debugging drivers that have poor interrupt latencies.

         Interrupt Latency Instrumentation should NOT be used in production
         systems.  It has a fairly large overhead to measure and collect the
         data.  It also should not be used with kernel preemption latency
         times collection as they will interfere with each other.

	 To set the interrupt latency timer speed pass tpu=XXX
	 on the command line, where XXX is the rate of the timer.  
	 If you do not know the rate of the timer being used on your system 
	 for interrupt latency measurement say N
	 to this feature.

         Say Y to this option if you are trying to understand the interrupt
         latency curve of your board.  This should be only used in the design
         and debug phase of your product.

config START_TMU1
	bool 
	default y
	depends on ILATENCY && SUPERH
endmenu
```
