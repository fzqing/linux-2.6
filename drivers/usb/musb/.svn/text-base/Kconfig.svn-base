## lib/Kconfig.FRD
```kconfig
#
# Fast Real-Time Domain Simulation (C) 2005 MontaVista Software, Inc.
#
#

menu "Fast Real-Time Domain"

config FRD
	bool "Enable Realtime Simulation Threads"
	select PROC_FS
	default n
	help
	  This option enables a Fast Realtime simulation,
	  where several high priority RT-threads interact
	  with an interrupt handler in a time-constrained
	  environment

config FRD_THREADS
	int "Number of real-time threads to run"
	depends on FRD
	range 3 40
	default 3
	help
	  Select the number of FRD threads to create



menu "Fast Real-Time Domain Advanced Options"

config FRD_TEST_ITERATIONS
	int "Number of test iterations to execute (0 for infinite)"
	depends on FRD
	default 0
	help
	  This option allows you to select the number of iterations
	  that the FRD threads will perform while collecting data. 
	  The actual execution time can be calculated from this setting
	  and the frequency of the interrupt source.


config FRD_PACING
	int "Pacing: Number of timer events between activations"
	depends on FRD
	default 0
	help
	  This option throttles the operation of FRD, for example
	  to allow debug output to be printed to the screen between 
	  activations. Assuming the timer period is 1 ms, pacing of 500 
	  would result in thread activations every 1/2 sec. 

config FRD_DELAY
	int "Startup delay: number of seconds before FRD startup"
	depends on FRD
	default 60 
	default 0
	help
	  This delay allows the kernel and system to fully boot before
	  measurement data logging begins. 


config FRD_WAKE_ALL
	bool "Wake ALL threads from IRQ handler"
	depends on FRD
	default n
	help
	  This option causes the interrupt handler to schedule all threads 
	  at the same time.  It can be used to verify proper task sequencing 
	  by the scheduler, corresponding to the thread priority sequence 
	  set below.


choice
	prompt "FRD thread priorities"
	depends on FRD
	default FRD_DESCENDING_PRIO
	help
	  Threads are woken up by ascending thread ids. Thread[0] is
	  woken up first. If the next thread ID is higher priority,
	  thread 0 will be preempted when it attemptst to wake up
	  thread 1. If the next thread ID is lower priority, a yield()
	  will take place instead, after thread 0 completes.

config FRD_ASCENDING_PRIO
	bool "Higher thread ids have higher priority (forced preemption)"
	depends on FRD
	help
	  This setting forces a lower priority thread to wake up a higher 
	  priority thread. Immediate preemption takes place, and additional 
	  scheduling overhead is incurred.

	  Choose this option to make frd[0] lowest priority. 
	  Thread frd[0] is woken from the IRQ, and then wakes
	  thread frd[1]. Since frd[1] is higher priority, the 
	  context switch occurs as soon as frd[1] has been woken.

config FRD_DESCENDING_PRIO
	bool "Higher thread ids have lower priority"
	depends on FRD
	help
	  This setting forces a higher priority thread to wake up a lower 
	  priority thread. The higher priority thread should complete 
	  without interruption before the lower priority thread runs. 

	  Choose this option to make frd[0] highest priority.
	  Thread frd[0] is woken from the IRQ, and then wakes
	  thread frd[1]. The context switch does not occur
	  until frd[0] has finished running.

config FRD_EQUAL_PRIO
	bool "All threads are highest priority"
	depends on FRD
	help
	  Choose this option to make all FRD threads highest priority. 
	  All threads compete for the CPU, and execution commences in 
	  the wake-up order. This option is not useful for measurements, 
	  but can be used to characterize scheduler behavior and is offered 
	  for completeness.

endchoice

config FRD_USE_TIMER_IRQ
	bool "Use the OS timer IRQ for thread wake-up"
	depends on FRD
	default y
	help
	  FRD depends on a hardware interrupt handler to mark the event 
	  which wakes up the threads. By default, the timer interrupt 
	  is used on all systems. The FRD hook for the default timer 
	  interrupt is found in kernel/timer.c. 
	  The following code must be added to use a dedicated IRQ other 
	  than the OS timer IRQ: 


          #if !defined CONFIG_FRD_USE_TIMER_IRQ
            if (check_frd_func_ptr)
                    check_frd_func_ptr();
          #endif
	
	  The dedicated IRQ must run with SA_NODELAY and SA_INTERRUPT.

	  Say Y if unsure.

config FRD_BUCKET_SIZE
	int "The size of bucket to use log real time thread latency"
	depends on FRD
	range 1 50
	default 2
	help
	  Histogram data is stored for a preemption latency data interval 
	  of (0,10000) microseconds. Smaller bucket size provides a 
	  higher resolution histogram but uses more memory. 

endmenu
endmenu
```

## net/ipv6/Kconfig
```kconfig
#
# IPv6 configuration
# 
config IPV6_PRIVACY
	bool "IPv6: Privacy Extensions (RFC 3041) support"
	depends on IPV6
	---help---
	  Privacy Extensions for Stateless Address Autoconfiguration in IPv6
	  support.  With this option, additional periodically-alter 
	  pseudo-random global-scope unicast address(es) will assigned to
	  your interface(s).
	
	  By default, kernel do not generate temporary addresses.
	  To use temporary addresses, do
	
	        echo 2 >/proc/sys/net/ipv6/conf/all/use_tempaddr 

	  See <file:Documentation/networking/ip-sysctl.txt> for details.

config IPV6_ROUTER_PREF
	bool "IPv6: default router preference"
	depends on IPV6

config IPV6_NEW_ROUNDROBIN
	bool
	depends on IPV6_ROUTER_PREF
	default y

config INET6_AH
	tristate "IPv6: AH transformation"
	depends on IPV6
	select XFRM
	select CRYPTO
	select CRYPTO_HMAC
	select CRYPTO_MD5
	select CRYPTO_SHA1
	---help---
	  Support for IPsec AH.

	  If unsure, say Y.

config INET6_ESP
	tristate "IPv6: ESP transformation"
	depends on IPV6
	select XFRM
	select CRYPTO
	select CRYPTO_HMAC
	select CRYPTO_MD5
	select CRYPTO_SHA1
	select CRYPTO_DES
	---help---
	  Support for IPsec ESP.

	  If unsure, say Y.

config INET6_IPCOMP
	tristate "IPv6: IPComp transformation"
	depends on IPV6
	select XFRM
	select INET6_TUNNEL
	select CRYPTO
	select CRYPTO_DEFLATE
	---help---
	  Support for IP Payload Compression Protocol (IPComp) (RFC3173),
	  typically needed for IPsec.

	  If unsure, say Y.

config INET6_TUNNEL
	tristate "IPv6: tunnel transformation"
	depends on IPV6
	select XFRM
	---help---
	  Support for generic IPv6-in-IPv6 tunnel transformation, which is
	  required by the IPv6-in-IPv6 tunneling module as well as tunnel mode
	  IPComp.
	  
	  If unsure, say Y.

config IPV6_TUNNEL
	tristate "IPv6: IPv6-in-IPv6 tunnel"
	depends on IPV6
	select INET6_TUNNEL
	---help---
	  Support for IPv6-in-IPv6 tunnels described in RFC 2473.

	  If unsure, say N.

config IPV6_STATISTICS
	bool "IPv6: per-interface statistics for SNMP"
	depends on IPv6

config IPV6_ADVANCED_ROUTER
	bool "IPv6: advanced router"
	depends on IPV6
	---help---
	  Support for advaced routing...

	  If unsure, say N.
config IPV6_SUBTREES
	bool "IPv6: source address routing"
	depends on IPV6_ADVANCED_ROUTER 
	---help---
	  Support for advanced routing by both source and destination address.

config IPV6_MULTIPLE_TABLES
	bool "IPv6: policy routing"
	depends on IPV6_ADVANCED_ROUTER 
	---help---
	  ...

	  If unsure, say N.

config IPV6_MIP6
	bool "IPv6: Mobility (EXPERIMENTAL)"
	depends on IPV6 && EXPERIMENTAL
	select XFRM
	select XFRM_USER
	select XFRM_ENHANCEMENT
	select IPV6_ADVANCED_ROUTER
	select IPV6_SUBTREES
	select IPV6_MULTIPLE_TABLES
	select INET6_TUNNEL
	---help---
	  Support for IPv6 Mobility.

	  If unsure, say N.

config IPV6_MIP6_DEBUG
	bool "IPv6: Moblity Debug Message"
	depends on IPV6_MIP6
	---help---
	  Be sure to say Y and record debug messages when submitting a
	  bug report.
	  If unsure, say N.
```

## net/xfrm/.svn/text-base/Kconfig.svn-base
```kconfig
#
# XFRM configuration
#
config XFRM_USER
	tristate "Transformation user configuration interface"
	depends on INET && XFRM
	---help---
	  Support for IPsec user configuration interface used
	  by native Linux tools.

	  If unsure, say Y.

config XFRM_ENHANCEMENT
	bool "Enhanced transformation (EXPERIMENTAL)"
	depends on INET	&& XFRM && EXPERIMENTAL
	---help---
	  Support for enhanced transformation.

	  If you want to use Mobile IPv6, say Y.

config XFRM_DEBUG
       bool "Transformation Debug Message"
       depends on XFRM_ENHANCEMENT
	---help---
	  You can say Y here if you want to get additional messages 
	  useful in debugging transformation code.
```

## sound/arm/.svn/text-base/Kconfig.svn-base
```kconfig
# ALSA ARM drivers

menu "ALSA ARM devices"
	depends on SND!=n && ARM

config SND_SA11XX_UDA1341
	tristate "SA11xx UDA1341TS driver (iPaq H3600)"
	depends on ARCH_SA1100 && SND && L3
	select SND_PCM
	help
	  Say Y here if you have a Compaq iPaq H3x00 handheld computer
	  and want to use its Philips UDA 1341 audio chip.

	  To compile this driver as a module, choose M here: the module
	  will be called snd-sa11xx-uda1341.

config SND_PXA2xx_SND
	tristate "AC97 driver for the Intel PXA2xx chip"
	depends on ARCH_PXA && SND && (!PXA3xx)
	select SND_PXA2xx_PCM
	select SND_PXA2xx_AC97
	select SND_AC97_CODEC
	help
	  Say Y or M if you want to support any AC97 codec attached to
	  the PXA2xx AC97 interface.

config SND_PXA3xx_SND
	tristate "AC97 driver for the Marvell PXA3xx chip"
	depends on PXA3xx && SND
	select SND_PXA2xx_PCM
	select SND_PXA2xx_AC97
	help
	  Say Y or M if you want to support Wolfson WM9713L codec
	  attached to the PXA3xx AC97 interface.

config SND_PXA2xx_AC97
	tristate
	depends on ARCH_PXA
	help
	  Generic driver for the ac97 bus on Intel/Marvell PXA2xx and
	  PXA3xx chips

config SND_PXA2xx_PCM
	tristate
	select SND_PCM
	help
	  Generic PCM module for PXA2xx

endmenu
```

## sound/oss/dm644x/Kconfig
```kconfig
# Menu for  Davinci DM644x based systems audio

menu " Davinci DM644x based systems audio support"
        depends on SOUND && (MACH_DAVINCI_EVM || MACH_DAVINCI_DM355_EVM)

config SOUND_DAVINCI
	tristate "DaVinci Sound Driver"
	depends on ARCH_DAVINCI && (MACH_DAVINCI_EVM || MACH_DAVINCI_DM355_EVM) && SOUND_PRIME!=n && SOUND
	select SOUND_DAVINCI_TLV320AIC33 if SOUND_DAVINCI
	---help---
	DaVinci Sound driver

config SOUND_DAVINCI_TLV320AIC33
       tristate "TLV320AIC33 Stereo Codec"
       depends on SOUND_DAVINCI
       default y if SOUND_DAVINCI
       select SENSORS_TLV320AIC33
       ---help---
         If you say yes here you get support for the I2C control
         interface for Texas Instruments TLV320AIC33 audio codec.

choice
	prompt "Mono/Stereo Jack Support"
	default MONOSTEREO_SAMEJACK

config MONOSTEREO_DIFFJACK
	bool "Mono and Stereo on different jacks"

config MONOSTEREO_SAMEJACK
	bool "Mono and Stereo on same jacks"
endchoice

endmenu
```

## sound/oss/dm646x/.svn/text-base/Kconfig.svn-base
```kconfig
# Menu for Davinci DM646x based systems audio

menu " Davinci DM646x based systems audio support"
        depends on SOUND && MACH_DAVINCI_HD_EVM


config SOUND_DAVINCI_HD
	tristate "DaVinci HD Sound Driver"
	depends on ARCH_DAVINCI && MACH_DAVINCI_HD_EVM && SOUND_PRIME!=n && SOUND
	---help---
	DaVinci HD Sound driver

config SOUND_DAVINCI_TLV320AIC32
       tristate "TLV320AIC32 Stereo Codec"
       depends on SOUND_DAVINCI_HD
       default y if SOUND_DAVINCI_HD
       select SENSORS_TLV320AIC33
       ---help---
         If you say yes here you get support for the I2C control
         interface for Texas Instruments TLV320AIC32 audio codec.

endmenu
```
