## lib/.svn/text-base/Kconfig.debug.svn-base
```kconfig
config DEBUG_KERNEL
	bool "Kernel debugging"
	depends on (ALPHA || ARM || CRIS || H8300 || X86 || IA64 || M32R || M68K || M68KNOMMU || MIPS || PARISC || PPC32 || PPC64 || ARCH_S390 || SUPERH || SUPERH64 || SPARC32 || SPARC64 || USERMODE || V850 || X86_64 || XTENSA)
	help
	  Say Y here if you are developing drivers or trying to debug and
	  identify kernel problems.

config MAGIC_SYSRQ
	bool "Magic SysRq key"
	depends on DEBUG_KERNEL && (ALPHA || ARM || X86 || IA64 || M32R || M68K || MIPS || PARISC || PPC32 || PPC64 || ARCH_S390 || SUPERH || SUPERH64 || SPARC32 || SPARC64 || X86_64 || USERMODE)
	help
	  If you say Y here, you will have some control over the system even
	  if the system crashes for example during kernel debugging (e.g., you
	  will be able to flush the buffer cache to disk, reboot the system
	  immediately or dump some status information). This is accomplished
	  by pressing various keys while holding SysRq (Alt+PrintScreen). It
	  also works on a serial console (on PC hardware at least), if you
	  send a BREAK and then within 5 seconds a command keypress. The
	  keys are documented in <file:Documentation/sysrq.txt>. Don't say Y
	  unless you really know what this hack does.

config MAGIC_SYSRQ
	bool "Magic SysRq key"
	depends on DEBUG_KERNEL && (H8300 || M68KNOMMU || V850)
	depends (USERMODE && MCONSOLE)
	help
	  Enables console device to interpret special characters as
	  commands to dump state information.

config SCHEDSTATS
	bool "Collect scheduler statistics"
	depends on DEBUG_KERNEL && PROC_FS
	help
	  If you say Y here, additional code will be inserted into the
	  scheduler and related routines to collect statistics about
	  scheduler behavior and provide them in /proc/schedstat.  These
	  stats may be useful for both tuning and debugging the scheduler
	  If you aren't debugging the scheduler or trying to tune a specific
	  application, you can say N to avoid the very slight overhead
	  this adds.

config DEBUG_SLAB
	bool "Debug memory allocations"
	depends on DEBUG_KERNEL && (ALPHA || ARM || X86 || IA64 || M32R || M68K || MIPS || PARISC || PPC32 || PPC64 || ARCH_S390 || SPARC32 || SPARC64 || USERMODE || X86_64)
	help
	  Say Y here to have the kernel do limited verification on memory
	  allocation as well as poisoning memory on free to catch use of freed
	  memory. This can make kmalloc/kfree-intensive workloads much slower.

config DEBUG_PREEMPT
	bool "Debug preemptible kernel"
	depends on PREEMPT
	default y
	help
	  If you say Y here then the kernel will use a debug variant of the
	  commonly used smp_processor_id() function and will print warnings
	  if kernel code uses it in a preemption-unsafe way. Also, the kernel
	  will detect preemption count underflows and will track critical
	  section entries and print that info when an illegal sleep happens.

# broken, disable for now
config DEBUG_SPINLOCK
	bool "Spinlock debugging"
	depends on 0 && (DEBUG_KERNEL && (ALPHA || ARM || X86 || IA64 || M32R || MIPS || PARISC || PPC32 || (SUPERH && !SUPERH64) || SPARC32 || SPARC64 || USERMODE || X86_64))
	default n
	help
	  Say Y here and build SMP to catch missing spinlock initialization
	  and certain other kinds of spinlock errors commonly made.  This is
	  best used in conjunction with the NMI watchdog so that spinlock
	  deadlocks are also debuggable.

config DEBUG_SPINLOCK_SLEEP
	bool "Sleep-inside-spinlock checking"
	depends on DEBUG_KERNEL && !DEBUG_PREEMPT && (X86 || IA64 || M32R || MIPS || PPC32 || PPC64 || ARCH_S390 || SPARC32 || SPARC64 || USERMODE)
	help
	  If you say Y here, various routines which may sleep will become very
	  noisy if they are called with a spinlock held.

config WAKEUP_TIMING
	bool "Wakeup latency timing"
	help
	  This option measures the time spent from a highprio thread being
	  woken up to it getting scheduled on a CPU, with microsecond
	  accuracy.

	  The default measurement method is a maximum search, which is
	  disabled by default and can be runtime (re-)started via:

	      echo 0 > /proc/sys/kernel/preempt_max_latency

config PREEMPT_TRACE
	bool
	default y
	depends on DEBUG_PREEMPT

config CRITICAL_PREEMPT_TIMING
	bool "Non-preemptible critical section latency timing"
	default n
	depends on PREEMPT
	help
	  This option measures the time spent in preempt-off critical
	  sections, with microsecond accuracy.

	  The default measurement method is a maximum search, which is
	  disabled by default and can be runtime (re-)started via:

	      echo 0 > /proc/sys/kernel/preempt_max_latency

	  (Note that kernel size and overhead increases with this option
	  enabled. This option and the irqs-off timing option can be
	  used together or separately.)

config CRITICAL_IRQSOFF_TIMING
	bool "Interrupts-off critical section latency timing"
	default n
	help
	  This option measures the time spent in irqs-off critical
	  sections, with microsecond accuracy.

	  The default measurement method is a maximum search, which is
	  disabled by default and can be runtime (re-)started via:

	      echo 0 > /proc/sys/kernel/preempt_max_latency

	  (Note that kernel size and overhead increases with this option
	  enabled. This option and the preempt-off timing option can be
	  used together or separately.)

config CRITICAL_TIMING
	bool
	default y
	depends on CRITICAL_PREEMPT_TIMING || CRITICAL_IRQSOFF_TIMING

config LATENCY_TIMING
	bool
	default y
	depends on WAKEUP_TIMING || CRITICAL_TIMING

config LATENCY_TRACE
	bool "Latency tracing"
	default n
	depends on LATENCY_TIMING
	help
	  This option enables a kernel tracing mechanism that will track
	  precise function-call granularity kernel execution during
	  wakeup paths or critical sections.  When this option is enabled
	  then the last maximum latency timing event's full trace can be
	  found in /proc/latency_trace, in a human-readable (or rather as
	  some would say, in a kernel-developer-readable) form.

	  (Note that kernel size and overhead increases noticeably
	  with this option enabled.)

config MCOUNT
	bool
	depends on LATENCY_TRACE
	default y

config RT_DEADLOCK_DETECT
	bool "Automatic mutex/rwsem deadlock detection"
	depends on PREEMPT_RT
	default y
	help
	  This allows semaphores, rw-semaphores, and spinlock/rwlock
	  mutexes to be traced for purposes of automatic deadlock
	  detection.

config DEBUG_KOBJECT
	bool "kobject debugging"
	depends on DEBUG_KERNEL
	help
	  If you say Y here, some extra kobject debugging messages will be sent
	  to the syslog. 

config DEBUG_HIGHMEM
	bool "Highmem debugging"
	depends on DEBUG_KERNEL && HIGHMEM && (X86 || PPC32 || MIPS || SPARC32)
	help
	  This options enables addition error checking for high memory systems.
	  Disable for production systems.

config DEBUG_BUGVERBOSE
	bool "Verbose BUG() reporting (adds 70K)"
	depends on DEBUG_KERNEL && (ARM || ARM26 || M32R || M68K || SPARC32 || SPARC64)
	help
	  Say Y here to make BUG() panics output the file name and line number
	  of the BUG call as well as the EIP and oops trace.  This aids
	  debugging but costs about 70-100K of memory.

config DEBUG_INFO
	bool "Compile the kernel with debug info"
	depends on DEBUG_KERNEL && (ALPHA || ARM || CRIS || X86 || IA64 || M32R || M68K || MIPS || PARISC || PPC32 || PPC64 || ARCH_S390 || (SUPERH && !SUPERH64) || SPARC64 || V850 || X86_64 || XTENSA)
	default y if KGDB
	help
          If you say Y here the resulting kernel image will include
	  debugging info resulting in a larger kernel image.
	  Say Y here only if you plan to use gdb to debug the kernel.
	  If you don't debug the kernel, you can say N.

config DEBUG_INFO
	bool "Enable kernel debugging symbols"
	depends on DEBUG_KERNEL && USERMODE
	help
        When this is enabled, the User-Mode Linux binary will include
        debugging symbols.  This enlarges the binary by a few megabytes,
        but aids in tracking down kernel problems in UML.  It is required
        if you intend to do any kernel development.

        If you're truly short on disk space or don't expect to report any
        bugs back to the UML developers, say N, otherwise say Y.

if !X86_64
config USE_FRAME_POINTER
	bool "Compile the kernel with frame pointers"
	depends on (X86 || CRIS || M68KNOMMU || SUPERH) && !MCOUNT
	default y if KGDB
	help
	  If you say Y here the resulting kernel image will be slightly larger
	  and slower, but it will give very useful debugging information.
	  If you don't debug the kernel, you can say N, but we may not be able
	  to solve problems without frame pointers.
endif

config FRAME_POINTER
	bool
	depends on USE_FRAME_POINTER || MCOUNT
	default y

config KGDB
	bool "KGDB: kernel debugging with remote gdb"
	depends on DEBUG_KERNEL && (ARM || X86 || MIPS || X86_64 || PPC64 || (SUPERH && !SUPERH64) || PPC32 || XTENSA)
	help
	  If you say Y here, it will be possible to remotely debug the
	  kernel using gdb. It is strongly suggested that you enable
	  DEBUG_INFO, and if available on your platform, FRAME_POINTER.
	  Documentation of kernel debugger available at
	  http://kgdb.sourceforge.net as well as in DocBook form
	  in Documentation/DocBook/.  If unsure, say N.

config KGDB_CONSOLE
	bool "KGDB: Console messages through gdb"
	depends on KGDB
	  help
	    If you say Y here, console messages will appear through gdb.
	    Other consoles such as tty or ttyS will continue to work as usual.
	    Note, that if you use this in conjunction with KGDB_ETH, if the
	    ethernet driver runs into an error condition during use with KGDB
	    it is possible to hit an infinite recusrion, causing the kernel
	    to crash, and typically reboot.  For this reason, it is preferable
	    to use NETCONSOLE in conjunction with KGDB_ETH instead of
	    KGDB_CONSOLE.

choice
	prompt "Method for KGDB communication"
	depends on KGDB
	default KGDB_ARM_VERSATILE if ARCH_VERSATILE
	default KGDB_SIBYTE if SIBYTE_SB1xxx_SOC
	default KGDB_MPSC if SERIAL_MPSC
	default KGDB_PXA_SERIAL if ARCH_PXA
	default KGDB_TXX9 if TOSHIBA_RBTX4927 || TOSHIBA_RBTX4938 || TOSHIBA_RBTX4939
	default KGDB_AU1X00 if SOC_AU1X00
	default KGDB_IP3106 if PNX8550
	default KGDB_CPM_UART if (8xx || 8260)
	default KGDB_8250
	help
	  There are a number of different ways in which you can communicate
	  with KGDB.  The most common is via serial, with the 8250 driver
	  (should your hardware have an 8250, or ns1655x style uart).
	  Another option is to use the NETPOLL framework and UDP, should
	  your ethernet card support this.  Other options may exist.

config KGDB_8250
	bool "KGDB: On generic serial port (8250)"
	select SERIAL_8250
	help
	  Uses generic serial port (8250) to communicate with the host
	  GDB.  This is independent of the normal (SERIAL_8250) driver
	  for this chipset.

config KGDB_CPM_UART
	bool "KGDB: On CPM UART"
	depends on CPM2 || 8xx
	help
	  Uses CPM UART to communicate with the host GDB.

config KGDB_SH_SCI
	bool "KGDB: On SH SCI(F) serial port"
	depends on SUPERH && SERIAL_SH_SCI
	help
	  Uses the SCI(F) serial port found on the board.

config KGDB_SIBYTE
	bool "KGDB: On the Broadcom SWARM serial port"
	depends on MIPS && SIBYTE_SB1xxx_SOC

config KGDB_ARM_VERSATILE
	bool "KGDB: On ARM Versatile"
	depends on ARM && ARCH_VERSATILE
	help
	  Enables the KGDB serial driver for the ARM Versatile

config KGDB_PXA_SERIAL
	bool "KGDB: On the PXA2xx serial port"
	depends on ARCH_PXA

config KGDB_TXX9
	bool "KGDB: On the TX4927/TX4937/TX4938/TX4939 serial port"
	help
	  Uses TX4927/TX4937/TX4938/TX4939 serial port to communicate with
	  the host GDB.

config KGDB_AU1X00
	bool "KGDB: On Au1x00 serial port"
	depends on SOC_AU1X00
	help
	  Uses Au1x00 serial port to communicate with the host GDB.

config KGDB_IP3106
	bool "KGDB: On the IP3106 serial port"
	depends on PNX8550
	select SERIAL_IP3106
	help
	  Enables th KGDB serial driver for for the PXA8550 platform.
	  You'll have to pick the baud rate and serial port (ttySA)
	  that you wish to use for KGDB via Kconfig or via the command-line
	  passing the option kgdb3106=portnumber,speed _BEFORE_ kgdbwait.
	  If choosed both then the comman-line options for kgdb override
	  the Kconfig ones.

config KGDB_ETH
	bool "KGDB: On ethernet"
	select NETPOLL
	select NETPOLL_TRAP
	select NETPOLL_RX
	help
	  Uses the NETPOLL API to communicate with the host GDB via UDP.
	  In order for this to work, the ethernet interface specified must
	  support the NETPOLL API, and this must be initialized at boot.
	  See the documentation for syntax.

config KGDB_MPSC
	bool "KGDB on MV64x60 MPSC"
	depends on SERIAL_MPSC
	help
	  Uses a Marvell GT64260B or MV64x60 Multi-Purpose Serial
	  Controller (MPSC) channel. Note that the GT64260A is not
	  supported.
endchoice

choice
 	prompt "  SCC/SMC for KGDB console"
 	depends on KGDB_CPM_UART
 	default KGDB_CPM_UART_SCC4 if ADS8272

config KGDB_CPM_UART_SCC1
 	bool "Use SCC1 for KGDB"
 	depends on SERIAL_CPM_SCC1

config KGDB_CPM_UART_SCC2
 	bool "Use SCC2 for KGDB"
 	depends on SERIAL_CPM_SCC2

config KGDB_CPM_UART_SCC3
 	bool "Use SCC3 for KGDB"
 	depends on SERIAL_CPM_SCC3

config KGDB_CPM_UART_SCC4
 	bool "Use SCC4 for KGDB"
 	depends on SERIAL_CPM_SCC4

config KGDB_CPM_UART_SMC1
 	bool "Use SMC1 for KGDB"
 	depends on SERIAL_CPM_SMC1

config KGDB_CPM_UART_SMC2
 	bool "Use SMC2 for KGDB"
 	depends on SERIAL_CPM_SMC2

endchoice

config KGDB_SIMPLE_SERIAL
	bool "Simple selection of KGDB serial port"
	depends on KGDB_8250 || KGDB_SH_SCI || KGDB_SIBYTE
	help
	  If you say Y here, you will only have to pick the baud rate
	  and serial port (ttyS) that you wish to use for KGDB.  If you
	  say N, you will have provide the I/O port and IRQ number.  Note
	  that if your serial ports are iomapped, such as on ia64, then
	  you must say Y here.  If in doubt, say Y.

choice
	depends on KGDB && !KGDB_ETH
    	prompt "Debug serial port BAUD"
	default KGDB_115200BAUD
	help
	  gdb and the kernel stub need to agree on the baud rate to be
	  used.  Standard rates from 9600 to 115200 are allowed, and this
	  may be overridden via the commandline.

config KGDB_9600BAUD
	bool "9600"

config KGDB_19200BAUD
	bool "19200"

config KGDB_38400BAUD
	bool "38400"

config KGDB_57600BAUD
	bool "57600"

config KGDB_115200BAUD
	bool "115200"
endchoice

choice
	prompt "Serial port for KGDB"
	depends on KGDB_SIMPLE_SERIAL
	default KGDB_TTYS0

config KGDB_TTYS0
	bool "ttyS0"

config KGDB_TTYS1
	bool "ttyS1"

config KGDB_TTYS2
	bool "ttyS2"

config KGDB_TTYS3
	bool "ttyS3"

endchoice

choice
	prompt "Serial port for KGDB"
	depends on KGDB_MPSC
	default KGDB_TTYMM0

config KGDB_TTYMM0
	bool "ttyMM0"

config KGDB_TTYMM1
	bool "ttyMM1"

endchoice

choice
	prompt "Serial port for KGDB"
	depends on KGDB_IP3106
	default KGDB_TTYSA0

config KGDB_TTYSA0
	bool "ttySA0"

config KGDB_TTYSA1
	bool "ttySA1"

endchoice

choice
	prompt "PXA serial UART for KGDB"
	depends on KGDB_PXA_SERIAL
	default KGDB_PXA_FFUART

config KGDB_PXA_FFUART
	bool "FFUART"

config KGDB_PXA_BTUART
	bool "BTUART"

config KGDB_PXA_STUART
	bool "STUART"

endchoice

config KGDB_PXA_BAUDRATE
	int "UART baudrate for KGDB"
	depends on KGDB_PXA_SERIAL
	default "115200"

config KGDB_PORT
	hex "hex I/O port address of the debug serial port"
	depends on !KGDB_SIMPLE_SERIAL && KGDB_8250 && !IA64
	default 3f8
	help
	  This is the unmapped (and on platforms with 1:1 mapping
	  this is typically, but not always the same as the mapped)
	  address of the serial port.  The stanards on your architecture
	  may be found in include/asm-$(ARCH)/serial.h.

config KGDB_IRQ
	int "IRQ of the debug serial port"
	depends on !KGDB_SIMPLE_SERIAL && KGDB_8250 && !IA64
	default 4
	help
	  This is the IRQ for the debug port.  This must be known so that
	  KGDB can interrupt the running system (either for a new
	  connection or when in gdb and control-C is issued).
```
